## sdkconfig.defaults
```kconfig
# --- Chip Target & Flash ---
CONFIG_IDF_TARGET="esp32s3"
CONFIG_ESPTOOLPY_FLASHSIZE_16MB=y
CONFIG_ESPTOOLPY_FLASHMODE_DIO=y
CONFIG_ESPTOOLPY_FLASHFREQ_80M=y

# --- PSRAM Configuration (8MB Octal) ---
CONFIG_SPIRAM=y
CONFIG_SPIRAM_MODE_OCT=y
CONFIG_SPIRAM_SPEED_80M=y
CONFIG_SPIRAM_BOOT_INIT=y
CONFIG_SPIRAM_MALLOC_RESERVE_INTERNAL=32768

# --- Partition Table ---
CONFIG_PARTITION_TABLE_CUSTOM=y
CONFIG_PARTITION_TABLE_CUSTOM_FILENAME="partitions.csv"

# --- FreeRTOS & Stack Sizes ---
CONFIG_ESP_MAIN_TASK_STACK_SIZE=16384
CONFIG_PTHREAD_TASK_STACK_SIZE_DEFAULT=8192
CONFIG_SYSTEM_EVENT_TASK_STACK_SIZE=4096

# --- LwIP (Networking) ---
CONFIG_LWIP_MAX_SOCKETS=16
CONFIG_UDP_RECVMBOX_SIZE=12
CONFIG_TCP_SND_BUF_DEFAULT=11520
CONFIG_TCP_WND_DEFAULT=11520

# --- Ethernet W5500 ---
CONFIG_ETH_USE_SPI_ETHERNET=y
CONFIG_ETH_SPI_ETHERNET_W5500=y

# --- HTTP Server (Web UI) ---
CONFIG_HTTPD_MAX_REQ_HDR_LEN=1024
CONFIG_HTTPD_MAX_URI_LEN=512
CONFIG_HTTPD_WS_SUPPORT=y

# --- Compiler Optimization ---
CONFIG_COMPILER_OPTIMIZATION_PERF=y
CONFIG_COMPILER_OPTIMIZATION_ASSERTION_LEVEL=2
```
